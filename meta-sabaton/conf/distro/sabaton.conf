## meta-sabaton/conf/distro/sabaton.conf
```bitbake
DISTRO_NAME = "Sabaton NDK"
DISTRO_VERSION = "0.1"
DISTRO_FEATURES_DEFAULT = "acl alsa argp ext2 ipv4 ipv6 largefile pcmcia usbgadget usbhost wifi xattr zeroconf pci nfc vfat"

DISTRO_FEATURES ?= "${DISTRO_FEATURES_DEFAULT} ${DISTRO_FEATURES_LIBC} \
                    "
# 4.19 LTS Kernel
#PREFERRED_VERSION_linux-yocto ?= "4.19%"

QEMU_TARGETS ?= "arm aarch64"
```

## yocto/meta-sabaton/conf/layer.conf
```bitbake
# We have a conf and classes directory, add to BBPATH
BBPATH .= ":${LAYERDIR}"

# We have recipes-* directories, add to BBFILES
BBFILES += "${LAYERDIR}/recipes-*/*/*.bb \
            ${LAYERDIR}/recipes-*/*/*.bbappend"

BBFILE_COLLECTIONS += "meta-sabaton"
BBFILE_PATTERN_meta-sabaton = "^${LAYERDIR}/"
BBFILE_PRIORITY_meta-sabaton = "6"

LAYERDEPENDS_meta-sabaton = "core"
LAYERSERIES_COMPAT_meta-sabaton = "hardknott"
```
